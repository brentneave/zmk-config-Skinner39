## boards/skinner39/Kconfig.defconfig
```kconfig
# Skinner39 board configuration

# Copyright (c) 2020 The ZMK Contributors
# SPDX-License-Identifier: MIT

if BOARD_SKINNER39_LEFT

config ZMK_KEYBOARD_NAME
	default "SKINNER39"

config ZMK_SPLIT_ROLE_CENTRAL
	default y

endif

if BOARD_SKINNER39_LEFT || BOARD_SKINNER39_RIGHT

config ZMK_SPLIT
	default y

if ZMK_DISPLAY

endif # ZMK_DISPLAY

if LVGL

config ZMK_DISPLAY_DEDICATED_THREAD_STACK_SIZE
	default 8192

config LV_Z_VDB_SIZE
	default 64

config LV_DPI_DEF
	default 148

config LV_Z_BITS_PER_PIXEL
	default 1

choice LV_COLOR_DEPTH
	default LV_COLOR_DEPTH_1
endchoice

endif # LVGL

config SPI
	default y

endif 
```

## boards/skinner39/Kconfig.skinner39
```kconfig
# Copyright (c) 2020 The ZMK Contributors
# SPDX-License-Identifier: MIT

config BOARD_SKINNER39_LEFT
    select SOC_NRF52840_QIAA

config BOARD_SKINNER39_RIGHT
    select SOC_NRF52840_QIAA
```

## boards/skinner39/skinner39_right_defconfig
```kconfig
# SPDX-License-Identifier: MIT

CONFIG_INPUT=y
CONFIG_ZMK_MOUSE=y
CONFIG_PMW3610_ALT=y
CONFIG_PMW3610_ALT_INVERT_Y=y
CONFIG_PMW3610_ALT_SMART_ALGORITHM=y

CONFIG_ZMK_EXT_POWER=y

CONFIG_ZMK_DISPLAY=y
CONFIG_SPI=y

CONFIG_PINCTRL=y
CONFIG_GPIO=y

CONFIG_BUILD_OUTPUT_UF2=y

CONFIG_NVS=y
CONFIG_SETTINGS_NVS=y
CONFIG_FLASH=y
CONFIG_FLASH_PAGE_LAYOUT=y
CONFIG_FLASH_MAP=y

CONFIG_ZMK_USB=y
CONFIG_ZMK_BLE=y
```

## config/west.yml
```yaml
manifest:
  remotes:
    - name: zmk
      url-base: https://github.com/zmkfirmware
    - name: badjeff
      url-base: https://github.com/badjeff
    - name: yangxing
      url-base: https://github.com/yangxing844
  projects:
    - name: zmk
      remote: zmk
      revision: abb64ba316c29caddc49727ca2cac2f0ed5970c7
      import: app/west.yml
    - name: zmk-pmw3610-driver
      remote: badjeff
      revision: 77635bad95097e2ed6fc16624622cff025a0e33b
    - name: zmk-split-peripheral-input-relay
      remote: badjeff
      revision: f49a5ca22a7b5626e37cffc73e97e64945bf9eb0
    - name: zmk-input-behavior-listener
      remote: badjeff
      revision: 80fc27026a28b99b6d3301898bcd894675e4e8a3
    - name: zmk-lpm009m360a-driver
      remote: yangxing
      revision: 06cbdb6e8ef691d6de9045645b6182d906f44b06
  self:
    path: config
```
